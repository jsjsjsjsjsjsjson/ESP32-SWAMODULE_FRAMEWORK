#ifndef NOTE_INPUT_H
#define NOTE_INPUT_H

#include "module_manager.hpp"
#include <freertos/queue.h>
#include "key_event.h"

const float midi2freq_float[128] = {
    8.1757989156f,
    8.6619572180f,
    9.1770239974f,
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    11839.8215267723f,
    12543.8539514160f
};

const int16_t midi2freq_int[128] = {
    8,
    9,
    9,
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    11840,
    12544
};

class noteEventModule: public Module_t {
public:

    noteEventModule() { module_info = {"Note Event", "libchara-dev", "A special module that outputs note event, frequency, and on/off status. (FreeRTOS only)", false, false}; }

    int16_t note = 0;
    int16_t freq = 0;   
    int16_t status = false;
    uint16_t timer = 0;
    key_event_t noteEvent;

    void start() {
        registerPort(&note, PORT_DOUT, "NOTE", "note event output");
        registerPort(&freq, PORT_AOUT, "FREQ", "frequency output");
        registerPort(&status, PORT_DOUT, "STATUS", "Note status (bool)");
    }
    void stop() {
        printf("Note Event Stop\n");
    }
    void process() {
        if (!(timer & 15)) {
            if (readNoteEvent == pdTRUE) {
                if (noteEvent.status == KEY_ATTACK) {
                    status = true;
                } else if (noteEvent.status == KEY_RELEASE) {
                    status = false;
                }
                note = noteEvent.num;
                freq = midi2freq_int[note];
            }
            
        }
        timer++;
    }
    void customSettingPage() {

    }
    void customViewPage() {

    }
};

#endif